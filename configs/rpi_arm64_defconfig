## configs/rpi_arm64_defconfig
```kconfig
CONFIG_ARM=y
CONFIG_POSITION_INDEPENDENT=y
CONFIG_ARCH_BCM283X=y
CONFIG_TARGET_RPI_ARM64=y
CONFIG_NR_DRAM_BANKS=8
CONFIG_ENV_SIZE=0x4000
CONFIG_DEFAULT_DEVICE_TREE="broadcom/bcm2711-rpi-4-b"
CONFIG_OF_LIBFDT_OVERLAY=y
CONFIG_DM_RESET=y
CONFIG_SYS_LOAD_ADDR=0x1000000
CONFIG_PCI=y
CONFIG_EFI_RUNTIME_UPDATE_CAPSULE=y
CONFIG_EFI_CAPSULE_FIRMWARE_RAW=y
CONFIG_BOOTSTD_DEFAULTS=y
CONFIG_OF_BOARD_SETUP=y
CONFIG_FDT_SIMPLEFB=y
CONFIG_USE_PREBOOT=y
CONFIG_PREBOOT="pci enum; nvme scan; usb start; if load usb :auto ${scriptaddr} persistent.env; then env import -t ${scriptaddr} ${filesize}; fi; if load usb :auto ${scriptaddr} once.env; then env import -t ${scriptaddr} ${filesize}; fatrm usb :auto once.env; fi; env export -t ${scriptaddr}; fatwrite usb :auto ${scriptaddr} machine.env ${filesize}"
CONFIG_SYS_PBSIZE=1049
# CONFIG_DISPLAY_CPUINFO is not set
# CONFIG_DISPLAY_BOARDINFO is not set
CONFIG_MISC_INIT_R=y
CONFIG_SYS_PROMPT="U-Boot> "
CONFIG_CMD_NVEDIT_EFI=y
CONFIG_CMD_NVEDIT_LOAD=y
CONFIG_CMD_GPIO=y
CONFIG_CMD_MMC=y
CONFIG_CMD_PCI=y
CONFIG_CMD_USB=y
CONFIG_CMD_EFIDEBUG=y
CONFIG_CMD_FS_UUID=y
CONFIG_CMD_IMPORTENV=y
CONFIG_CMD_EXPORTENV=y
CONFIG_ENV_OVERWRITE=y
CONFIG_ENV_IS_NOWHERE=y
CONFIG_ENV_VARS_UBOOT_CONFIG=y
CONFIG_VERSION_VARIABLE=y
CONFIG_ENV_VARS_UBOOT_RUNTIME_CONFIG=y
# UEFI variable persistence
CONFIG_FAT_WRITE=y
CONFIG_EFI_VARIABLE_FILE_STORE=y
# CONFIG_ENV_RELOC_GD_ENV_ADDR=y
CONFIG_TFTP_TSIZE=y
CONFIG_DM_DMA=y
CONFIG_DFU_MMC=y
CONFIG_DFU_OVER_USB=y
CONFIG_SYS_DFU_DATA_BUF_SIZE=0x100000
CONFIG_SYS_DFU_MAX_FILE_SIZE=0x200000
CONFIG_BCM2835_GPIO=y
CONFIG_MMC_SDHCI=y
CONFIG_MMC_SDHCI_SDMA=y
CONFIG_MMC_SDHCI_BCM2835=y
CONFIG_MMC_SDHCI_BCMSTB=y
CONFIG_BCMGENET=y
CONFIG_PCI_BRCMSTB=y
CONFIG_PINCTRL=y
# CONFIG_PINCTRL_GENERIC is not set
CONFIG_DM_RNG=y
CONFIG_RNG_IPROC200=y
# CONFIG_REQUIRE_SERIAL_CONSOLE is not set
CONFIG_SYSINFO=y
CONFIG_SYSINFO_SMBIOS=y
CONFIG_USB=y
CONFIG_USB_XHCI_HCD=y
CONFIG_USB_XHCI_PCI=y
CONFIG_USB_DWC2=y
CONFIG_USB_KEYBOARD=y
CONFIG_USB_HOST_ETHER=y
CONFIG_USB_ETHER_LAN78XX=y
CONFIG_USB_ETHER_SMSC95XX=y
CONFIG_VIDEO=y
# CONFIG_VIDEO_BPP8 is not set
# CONFIG_VIDEO_BPP16 is not set
CONFIG_SYS_WHITE_ON_BLACK=y
CONFIG_VIDEO_BCM2835=y
CONFIG_CONSOLE_SCROLL_LINES=10
CONFIG_PHYS_TO_BUS=y
# CONFIG_HEXDUMP is not set
CONFIG_BCM2712=y
CONFIG_MFD_RP1=y
CONFIG_RP1_GPIO=y
CONFIG_RESET_BRCMSTB=y
CONFIG_RESET_BRCMSTB_RESCAL=y
CONFIG_CLK=y
CONFIG_SYS_PCI_64BIT=y
CONFIG_MACB=y
# Enable NVME
CONFIG_NVME_PCI=y
CONFIG_CMD_NVME=y
CONFIG_NVME=y
# USB mass storage support
CONFIG_CMD_USB_MASS_STORAGE=y
CONFIG_USB_DWC3=y
CONFIG_USB_XHCI_DWC3=y
CONFIG_BLKMAP=y
# Boot config
CONFIG_BOOTSTD=y
CONFIG_BOOTMETH_EFILOADER=n
CONFIG_PXE_UTILS=n
# EFI
CONFIG_EFI_BOOTMGR=n
CONFIG_CMD_BOOTEFI_BOOTMGR=n
# Expo Menu
CONFIG_BOOTSTD_FULL=y
CONFIG_BOOTSTD_BOOTCOMMAND=y
# CONFIG_EXPO=y
# CONFIG_BOOTSTD_MENU=y
# CONFIG_CMD_BOOTMENU=y
# CONFIG_CMD_BOOTFLOW_FULL=y
# CONFIG_AUTOBOOT_MENU_SHOW=y
# PXE
CONFIG_DHCP_PXE_CLIENTARCH=0xb
CONFIG_BOOTP_VCI_STRING="PXEClient"
CONFIG_BOOTP_PXE=y
CONFIG_BOOTP_PXE_DHCP_OPTION=y
CONFIG_BOOTP_MAY_FAIL=y
CONFIG_SERVERIP_FROM_PROXYDHCP=y
CONFIG_BOOTP_SEND_HOSTNAME=y
CONFIG_BOOTP_DNS2=y
CONFIG_BOOTP_NTPSERVER=y
# SMBIOS
CONFIG_GENERATE_SMBIOS_TABLE=y
CONFIG_CMD_SMBIOS=y
CONFIG_LOCALVERSION_AUTO=n
```
